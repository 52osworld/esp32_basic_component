## components/socket_msg/Kconfig
```kconfig
menu "SocketMsg Config"

config SOCKET_MSG
    bool "SocketMsg"
    default n
    help
	    enable SocketMsg.

config SOCKET_IP
    string "Socket server IP"
    default "192.168.31.242"
    depends on SOCKET_MSG
    help
        The Remote Server IP.

config SOCKET_PORT
    int "Socket server Port"
    default "61028"
    depends on SOCKET_MSG
    help
        The Remote Server port.

endmenu
```

## components/user_spiffs/Kconfig
```kconfig
menu "USER SPIFFS Config"

config FORMAT_IF_MOUNT_FAILED
    bool "Format if Mount failed"
    default "y"
    help
        if the spiffs image in flash is mount failed, format the spiffs flash partition

config TEST_SPIFFS
    bool "Test spiffs"
    default "y"
    help
        Do a spiffs test in this example
endmenu
```

## main/Kconfig.projbuild
```kconfig
menu "User Configuration"
source ../components/user_wifi/Kconfig
source ../components/socket_msg/Kconfig
source ../components/user_spiffs/Kconfig

endmenu
```
